## products/Replica_ai/doc/demo_mini/speaker-display-mini/sdkconfig.defaults
```kconfig
# Speaker Display Mini 默认配置
CONFIG_IDF_TARGET="esp32s3"
CONFIG_APP_PROJECT_VER_FROM_CONFIG=y
CONFIG_APP_PROJECT_VER="0.1.0"

# BSP / LVGL 基本需求
CONFIG_SPIRAM=y
CONFIG_SPIRAM_MODE_OCT=y
CONFIG_SPIRAM_SPEED_80M=y
CONFIG_ESP_DEFAULT_CPU_FREQ_MHZ_240=y
CONFIG_BSP_LCD_DRAW_BUF_HEIGHT=20
CONFIG_BSP_LCD_DRAW_BUF_DOUBLE=y

# 控制台 & 调试
CONFIG_ESP_CONSOLE_USB_SERIAL_JTAG=y

# FreeRTOS/LVGL 建议配置
CONFIG_FREERTOS_HZ=1000
CONFIG_LV_DEF_REFR_PERIOD=10
CONFIG_LV_USE_LOG=y
CONFIG_LV_LOG_PRINTF=y
```

## products/Replica_ai/doc/demo_mini/speaker-voice-mini/main/Kconfig.projbuild
```kconfig
menu "Example Configuration"

    menuconfig EXAMPLE_COZE_AGENT_ENABLE_DEFAULT_CONFIG
        bool "Default coze agent config"
        default n

    if EXAMPLE_COZE_AGENT_ENABLE_DEFAULT_CONFIG


        config EXAMPLE_COZE_AGENT_PRIVATE_KEY_FILE_PATH
            string "Private key"
            default "./private_key.pem"


    endif

endmenu
```

## products/base/sdkconfig.defaults
```kconfig
# ESP-Brookesia Learning Project - Default Configuration
# Based on Speaker product configuration

# ====================================
# ESP-IDF SDK Configuration
# ====================================

# ESP32-S3 specific configuration
CONFIG_IDF_TARGET_ESP32S3=y

# CPU Frequency
CONFIG_ESP32S3_DEFAULT_CPU_FREQ_240=y

# ====================================
# ESP-Brookesia Core Configuration
# ====================================

# Enable Systems
CONFIG_ESP_BROOKESIA_ENABLE_SYSTEMS=y
CONFIG_ESP_BROOKESIA_SYSTEMS_ENABLE_BASE=y

# Enable GUI
CONFIG_ESP_BROOKESIA_ENABLE_GUI=y

# Enable Services
CONFIG_ESP_BROOKESIA_ENABLE_SERVICES=y
CONFIG_ESP_BROOKESIA_SERVICES_ENABLE_STORAGE_NVS=y

# Disable AI Framework for Lesson 1
CONFIG_ESP_BROOKESIA_ENABLE_AI_FRAMEWORK=n

# ====================================
# LVGL Configuration
# ====================================

# LVGL version 9
CONFIG_LV_LVGL_H_INCLUDE_SIMPLE=y

# Color depth
CONFIG_LV_COLOR_DEPTH_16=y

# Screen size
CONFIG_LV_HOR_RES_MAX=360
CONFIG_LV_VER_RES_MAX=360

# Enable LVGL built-in styles
CONFIG_LV_USE_STYLE_GEN=y

# ====================================
# Memory Configuration
# ====================================

# Memory allocation
CONFIG_SPIRAM_USE_MALLOC=y
CONFIG_SPIRAM_USE_CAPS_ALLOC=y
CONFIG_SPIRAM_USE_MALLOC_ALWAYSINTERNAL=16384

# ====================================
# Log Configuration
# ====================================

# Log level for ESP-Brookesia
CONFIG_LOG_DEFAULT_LEVEL_INFO=y

# Enable debug logs for learning
CONFIG_ESP_BROOKESIA_ENABLE_DEBUG_LOG=y
```
